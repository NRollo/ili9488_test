## main/Kconfig.projbuild
```kconfig
menu "ILI9488 Display Configuration"

    config ILI9488_SPI_HOST
        int "SPI host (1 = HSPI/SPI2, 2 = VSPI/SPI3)"
        range 1 2
        default 2

    config ILI9488_PIN_MOSI
        int "MOSI (SDI) GPIO"
        default 23

    config ILI9488_PIN_SCLK
        int "SCLK (SCK) GPIO"
        default 18

    config ILI9488_PIN_CS
        int "CS GPIO"
        default 5

    config ILI9488_PIN_DC
        int "DC (RS) GPIO"
        default 21

    config ILI9488_PIN_RST
        int "RESET GPIO (-1 = not connected)"
        default 22

    config ILI9488_PIN_BL
        int "Backlight GPIO (-1 = tied to 3V3)"
        default 32

    config ILI9488_BL_ACTIVE_HIGH
        bool "Backlight is active high"
        default y

    config ILI9488_SPI_CLOCK_MHZ
        int "SPI clock in MHz"
        range 1 80
        default 40
        help
            ILI9488 is rated ~20 MHz for writes, but most modules work at 40 MHz
            with short wires. Lower this if you see garbage or noise.

    config ILI9488_ROTATION
        int "Rotation (0/2 = portrait 320x480, 1/3 = landscape 480x320)"
        range 0 3
        default 1

endmenu

menu "XPT2046 Touch Configuration"

    config XPT2046_ENABLE
        bool "Enable XPT2046 touch test"
        default y
        help
            Runs a 3-point calibration and a touch paint test before the display tests.
            The touch controller shares MOSI/SCLK with the display.

    config XPT2046_PIN_MISO
        int "MISO (T_DO) GPIO"
        default 19
        depends on XPT2046_ENABLE

    config XPT2046_PIN_CS
        int "Touch CS (T_CS) GPIO"
        default 4
        depends on XPT2046_ENABLE

    config XPT2046_PIN_IRQ
        int "Touch IRQ (T_IRQ) GPIO (-1 = not connected)"
        default 27
        depends on XPT2046_ENABLE

    config XPT2046_SPI_CLOCK_KHZ
        int "Touch SPI clock in kHz"
        range 100 2500
        default 2000
        depends on XPT2046_ENABLE

    config XPT2046_Z_THRESHOLD
        int "Pressure threshold for a touch"
        range 50 3000
        default 300
        depends on XPT2046_ENABLE
        help
            Raise this if phantom touches are reported, lower it if light touches are missed.

endmenu
```
